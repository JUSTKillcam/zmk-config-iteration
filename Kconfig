## Kconfig
```kconfig
DT_COMPAT_ZMK_LAYER_RELAY_DISPLAY := zmk,layer-relay-display

config ZMK_LAYER_RELAY_DISPLAY
    bool "Show the layer relayed from the central on the peripheral nice!view"
    default $(dt_compat_enabled,$(DT_COMPAT_ZMK_LAYER_RELAY_DISPLAY))
    depends on ZMK_DISPLAY && ZMK_SPLIT && !ZMK_SPLIT_ROLE_CENTRAL
    select ZMK_OUTPUT_BEHAVIOR_LISTENER
    select LV_USE_CANVAS
    select LV_USE_IMG
    select LV_FONT_MONTSERRAT_16
```

## dts/bindings/zmk,layer-relay-display.yaml
```yaml
description: |
  Receives the active layer from the central (via zmk-split-peripheral-output-relay)
  and shows it on the peripheral nice!view. Value sent = layer index + 1.

compatible: "zmk,layer-relay-display"

properties:
  layer-names:
    type: string-array
    required: true
```
