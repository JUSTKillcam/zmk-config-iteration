&kscan0 {
    col-gpios
        = <&pro_micro 18 GPIO_ACTIVE_HIGH> // pinky
        , <&pro_micro 9  GPIO_ACTIVE_HIGH> // ring
        , <&pro_micro 8  GPIO_ACTIVE_HIGH> // middle
        , <&pro_micro 7  GPIO_ACTIVE_HIGH> // index
        , <&pro_micro 6  GPIO_ACTIVE_HIGH> // inner
        , <&pro_micro 5  GPIO_ACTIVE_HIGH> // screen
        , <&pro_micro 16 GPIO_ACTIVE_HIGH> // thumb near
        , <&pro_micro 15 GPIO_ACTIVE_HIGH> // thumb home
        , <&pro_micro 14 GPIO_ACTIVE_HIGH> // thumb far
        ;

    row-gpios
        = <&pro_micro 2 (GPIO_ACTIVE_HIGH | GPIO_PULL_DOWN)> // top
        , <&pro_micro 3 (GPIO_ACTIVE_HIGH | GPIO_PULL_DOWN)> // home
        , <&pro_micro 4 (GPIO_ACTIVE_HIGH | GPIO_PULL_DOWN)> // bottom
        , <&pro_micro 10 (GPIO_ACTIVE_HIGH | GPIO_PULL_DOWN)> // thumb row
        ;
};