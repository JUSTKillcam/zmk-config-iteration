#include "iteration.dtsi"

/ {
    kscan0: kscan0 {
        compatible = "zmk,kscan-gpio-matrix";
        diode-direction = "col2row";
        wakeup-source;

        col-gpios
            = <&pro_micro 18 GPIO_ACTIVE_HIGH>
            , <&pro_micro 9 GPIO_ACTIVE_HIGH>
            , <&pro_micro 8 GPIO_ACTIVE_HIGH>
            , <&pro_micro 7 GPIO_ACTIVE_HIGH>
            , <&pro_micro 6 GPIO_ACTIVE_HIGH>
            , <&pro_micro 5 GPIO_ACTIVE_HIGH>
            , <&pro_micro 16 GPIO_ACTIVE_HIGH>
            , <&pro_micro 15 GPIO_ACTIVE_HIGH>
            , <&pro_micro 14 GPIO_ACTIVE_HIGH>
            ;

        row-gpios
            = <&pro_micro 2 (GPIO_ACTIVE_HIGH | GPIO_PULL_DOWN)>
            , <&pro_micro 3 (GPIO_ACTIVE_HIGH | GPIO_PULL_DOWN)>
            , <&pro_micro 4 (GPIO_ACTIVE_HIGH | GPIO_PULL_DOWN)>
            , <&pro_micro 10 (GPIO_ACTIVE_HIGH | GPIO_PULL_DOWN)>
            ;
    };
};

&physical_layout_iteration {
    kscan = <&kscan0>;
};


/*
 * Layer relay (central side): on every layer change, send
 * "highest active layer + 1" to the right half over Bluetooth.
 */
#define OUTPUT_SOURCE_LAYER_STATE_CHANGE 1

/ {
    layer_relay: layer_relay {
        compatible = "zmk,output-split-output-relay";
        #binding-cells = <0>;
    };

    layer_relay_channel {
        compatible = "zmk,split-peripheral-output-relay";
        device = <&layer_relay>;
        relay-channel = <201>;
    };

#define LAYER_RELAY(n)                                                         \
    ob_layer_##n: ob_layer_##n {                                               \
        compatible = "zmk,output-behavior-generic";                            \
        #binding-cells = <0>;                                                  \
        device = <&layer_relay>;                                               \
        force = <(n + 1)>;                                                     \
        momentum;                                                              \
        momentum-force = <(n + 1)>;                                            \
    };                                                                         \
    obl_layer_##n {                                                            \
        compatible = "zmk,output-behavior-listener";                           \
        layers = <n>;                                                          \
        sources = <OUTPUT_SOURCE_LAYER_STATE_CHANGE>;                          \
        all-state;                                                             \
        bindings = <&ob_layer_##n>;                                            \
    };

    LAYER_RELAY(0)
    LAYER_RELAY(1)
    LAYER_RELAY(2)
    LAYER_RELAY(3)
    LAYER_RELAY(4)
    LAYER_RELAY(5)
};
